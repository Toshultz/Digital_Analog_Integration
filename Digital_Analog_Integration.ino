
/*
  SD card datalogger
 
  connect to ISP pins on Due. 
  chipSelect = 4
    
 */
//


///////////////////////////Analog constants////////////////
//typedef enum _bool {false = 0, true } bool;    /* Undefined size */
typedef unsigned long           DWORD;                          /* 32-bit unsigned */
typedef unsigned char           BYTE;                           /* 8-bit unsigned  */
typedef unsigned short int      WORD;
//Define Input



int mr_cal = 0;
int MUX_C1 = 42;
int MUX_B1 = 43;
int PAENABLE = 33;
int MOTOR_CONTROL = 34;
int PA_switch = 37;
int FS_GMR1 = 38;
int FS_Coil = 39;
int AUTOGAINA3 = 40;
int AUTOGAINA2 = 41;

int ADC_SCK = 50;
int BUSY = 48;
int CNV = 47;
int ADC_SDI = 51;

//int ADC_SDO = 49;
//int B_CONVST = 46;

int MUX_A0 = 45;
int MUX_B0 = 36;
int MUX_C0 = 28;
int MUX_D0 = 14;

int MUX_A1 = 15;
int AUTOGAINA0 = 29;
int AUTOGAINA1 = 11;
int SCLK_SIGSYN = 12;
int SDO_SIGSYN = 30;

//double resistorarray[16] = {1300, 1315, 1345,1370,1400,1430,1460,1490,1515, 1545,1575,1605,1635, 1665,1695,1725};
double resistorarray[16] = {1500, 1515, 1530, 1545, 1560, 1575, 1591, 1605, 1620, 1635, 1650, 1665, 1680, 1695, 1711, 1725};

double AMP1[80];
double sidedata = 0;
double carrierdata = 0;
double correctedsidedata = 0;
double correctedmr = 0;
double sidemul2 = 0;
double sidemul = 0;
double carriermul = 0;

double temp = 0;
long dummy = 0;
char dummy_a = 0;
long dummy_data = 0;

short two_byte_short = 0;


int carrierfrequency = 155;//541;//227;//280; //297;//158;//102;//122;//150: 153;//115;//217;//110;//147;//67;//170;//113;//61;//158;//282;
int sidefrequency = 115;//361;//422;//489;//251;//161;//220;//150:210;//72;//173;//177;//97;//156;//155;//107;//266;//89;
int sidefrequency2 = 197;//41;// 676;//93;//

int freq_bin = 20;//15
int side_bin1 = 20;//30
int side_bin2 = 20;//25;

//363:34
int tempcarrierfrequency = 323;
int tempsidefrequency = 333;
int tempsidefrequency2 = 333;
double mrmedian = 670;//770;//840;//285;//685;//2100;//2800;//3106;//1263;//27000;
byte table[80];

float FTvl[2048 * 2];
double mr_factor[80];

long AVal[2048 * 2];
int Nvl = 2048 * 2;
int Nft = 2048 * 2;

float hann[4096] = {0,9.61234245958253e-07,3.84493472104014e-06,8.65109463605109e-06,1.53797026763921e-05,2.40307430009719e-05,3.46041952433853e-05,4.71000345110069e-05,6.15182313854441e-05,7.78587519228999e-05,9.61215576537197e-05,0.000116306605582663,0.000138413848189357,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9.61234245958253e-07,0};

short N = 2048 * 2;
long mean_long = 0;
short mean_short = 0;

double tempcarrierarray[51];
double tempsidearray[51];
double AMP23 = 29.64;//53.41;//60.8;//4.3;//60.8;//52;//78.9264;
double AMP2 = 6.05;

double involt_power = 0.29 * 0.29 / 2;

int state;
int state1;
int ab;
byte flag = 0;      //makes sure that the serial only prints once the state

unsigned char test;
int autogainres[80];


double Ic = 0;
double Is = 0;
double corrected_Is = 0;
double Ic_original[80];

double Is_original[80];
double Rf_Cf_side = 2485;
double Rf_Cf_carrier = 2488;
double Vc_acq_rms = 0;
double Vs_acq_rms = 0;
double involt_rms = 0.2021;

double CF = 0;
double k = 5;//2.87; //7.8
double mr0[80];
double deltamr;

long wint = 0;
long wmax = 0;
long wmin = 0;
int row = 0;
int col = 0;
int count = 0;
unsigned short int data = 0;

BYTE target = 0;
BYTE sampling = 0;
int res;
unsigned long int wrange[16];
int wrangesmallest;

unsigned short int w1 = 0;

//int b=0;


//byte rowarray[] = {3, 7, 1, 5, 2, 6, 8, 9, 0, 4}; // MY CARTRIDGE _ for mari detection
byte rowToMux[] = {7, 5, 6, 9, 4, 0, 8, 2, 1, 3};
byte colarray[] = {0, 1, 2, 3, 4, 5, 6, 7}; // MY CARTRIDGE


int rown = 0;
int coln = 0;

bool autogain = false;

int rowncoln = 0;
bool faulty[16];
bool faultysensor = true ;
int buffer_int1 = 0;

int buffer_test = 0;
int counting = 0;
BYTE ToSendDataBuffer1[160];

unsigned long int w;

////////////////////////////Analog Functions/////////////////////////
void SPI_COIL_SEND(unsigned short int data) //WORD is 2bytes = 16bit
{
  char a = 15;
  unsigned short int b;
  BYTE c = 0;
  digitalWrite(FS_Coil, HIGH);
  for (ab = 0; ab < 1000; ab++);
  digitalWrite(SCLK_SIGSYN, HIGH);
  for (ab = 0; ab < 1000; ab++);
  digitalWrite(FS_Coil, LOW);
  for (ab = 0; ab < 1000; ab++);
  for (int a = 15; a > -1; a--)
  {
    for (ab = 0; ab < 1000; ab++);
    b = data >> a;
    for (ab = 0; ab < 1000; ab++);
    c = b & 1;
    for (ab = 0; ab < 1000; ab++);
    digitalWrite(SCLK_SIGSYN, HIGH);
    for (ab = 0; ab < 1000; ab++);
    if (c == 1)
    {
      digitalWrite(SDO_SIGSYN, HIGH);
      //  for(ab = 0; ab < 1000; ab++);
      digitalWrite(SCLK_SIGSYN, LOW);
      //  for(ab = 0; ab < 1000; ab++);
    }
    else
    {
      digitalWrite(SDO_SIGSYN, LOW);
      for (ab = 0; ab < 1000; ab++);
      digitalWrite(SCLK_SIGSYN, LOW);
      for (ab = 0; ab < 1000; ab++);
    }

  }
  digitalWrite(FS_Coil, HIGH);
  //for(ab = 0; ab < 1000; ab++);

}

void MULTIPLIER2_on(int a)//row up to down 27360514
{



  // row = a;
  //MULTIENH;

  if ((a & 0b00000001) == 1)
  {
    digitalWrite(MUX_A0, HIGH);
  }
  else
  {
    digitalWrite(MUX_A0, LOW);
  }

  if ((a & 0b00000010) == 0b00000010)
  {
    digitalWrite(MUX_B0, HIGH);
  }
  else
  {
    digitalWrite(MUX_B0, LOW);
  }

  if ((a & 0b00000100) == 0b00000100)
  {
    digitalWrite(MUX_C0, HIGH);
  }
  else
  {
    digitalWrite(MUX_C0, LOW);
  }

  if ((a & 0b00001000) == 0b00001000)
  {
    digitalWrite(MUX_D0, HIGH);
  }
  else
  {
    digitalWrite(MUX_D0, LOW);
  }


}
void MULTIPLIER1_on(int a)//column left to right
{



  if ((a & 0b00000001) == 1)
  {
    digitalWrite(MUX_A1, HIGH);
  }
  else
  {
    digitalWrite(MUX_A1, LOW);
  }

  if ((a & 0b00000010) == 0b00000010)
  {
    digitalWrite(MUX_B1, HIGH);
  }
  else
  {
    digitalWrite(MUX_B1, LOW);
  }

  if ((a & 0b00000100) == 0b00000100)
  {
    digitalWrite(MUX_C1, HIGH);
  }
  else
  {
    digitalWrite(MUX_C1, LOW);
  }
}

void AUTOGAINMUX_on(int a)
{



  if ((a & 0b00000001) == 1)
  {
    digitalWrite(AUTOGAINA0, HIGH);
  }
  else
  {
    digitalWrite(AUTOGAINA0, LOW);
  }

  if ((a & 0b00000010) == 0b00000010)
  {
    digitalWrite(AUTOGAINA1, HIGH);
  }
  else
  {
    digitalWrite(AUTOGAINA1, LOW);
  }

  if ((a & 0b00000100) == 0b00000100)
  {
    digitalWrite(AUTOGAINA2, HIGH);
  }
  else
  {
    digitalWrite(AUTOGAINA2, LOW);
  }

  if ((a & 0b00001000) == 0b00001000)
  {
    digitalWrite(AUTOGAINA3, HIGH);
  }
  else
  {
    digitalWrite(AUTOGAINA3, LOW);
  }
}




void SPI_GMR1_SEND(unsigned short int data) //WORD is 2bytes = 16bit
{
  unsigned short int b;
  BYTE c = 0;
  for (ab = 0; ab < 10; ab++);
  digitalWrite(FS_GMR1, HIGH);
  for (ab = 0; ab < 10; ab++);
  digitalWrite(SCLK_SIGSYN, HIGH);
  for (ab = 0; ab < 10; ab++);
  digitalWrite(FS_GMR1, LOW);
  for (ab = 0; ab < 10; ab++);
  for (int a = 15; a > -1; a--)
  {

    for (ab = 0; ab < 10; ab++);
    b = data >> a;
    for (ab = 0; ab < 10; ab++);
    c = b & 1;
    for (ab = 0; ab < 10; ab++);


    if (c == 1)
    {
      digitalWrite(SCLK_SIGSYN, HIGH);
      for (ab = 0; ab < 10; ab++);
      digitalWrite(SDO_SIGSYN, HIGH);
      for (ab = 0; ab < 10; ab++);
      digitalWrite(SCLK_SIGSYN, LOW);
      for (ab = 0; ab < 10; ab++);
    }
    else
    {
      digitalWrite(SCLK_SIGSYN, HIGH);
      for (ab = 0; ab < 10; ab++);
      digitalWrite(SDO_SIGSYN, LOW);
      for (ab = 0; ab < 10; ab++);
      digitalWrite(SCLK_SIGSYN, LOW);
      for (ab = 0; ab < 10; ab++);
    }
  }
  digitalWrite(FS_GMR1, HIGH);
  for (ab = 0; ab < 10; ab++);
}

unsigned long int SPI_ADC_RECEIVE(void) //WORD is 2bytes = 16bit
{
 dummy_data = 0;
 dummy_a = 0;

  digitalWriteDirect(CNV,HIGH);
  digitalWriteDirect(CNV,LOW);

  //BUSY PIN SHOULD BE ACQUID, READ SDI_ADC AT THE RISING EDGE OF SCK
  while ( (digitalReadDirect(BUSY)) == 1); //INT? ==1, BUSY?==0

  while (dummy_a < 19)
  {
    dummy_data = dummy_data + digitalRead(ADC_SDI); // digitalReadDirect(ADC_SDI);
    digitalWriteDirect(ADC_SCK,LOW);
    dummy_data = dummy_data << 1;
    digitalWriteDirect(ADC_SCK,HIGH);
    dummy_a++;
  }
  dummy_data = dummy_data + digitalRead(ADC_SDI);
  digitalWriteDirect(ADC_SCK,LOW);
  digitalWriteDirect(ADC_SCK,HIGH);

  return dummy_data;

}

inline void digitalWriteDirect(int pin, boolean val){
  if(val) g_APinDescription[pin].pPort -> PIO_SODR = g_APinDescription[pin].ulPin;
  else    g_APinDescription[pin].pPort -> PIO_CODR = g_APinDescription[pin].ulPin;
}
inline int digitalReadDirect(int pin){
  return !!(g_APinDescription[pin].pPort -> PIO_PDSR & g_APinDescription[pin].ulPin);
}

void FFTAnalysis(float* FTvl, long* AVal, int Nvl, int Nft) {  //Nft is number of array // Nvl number of input
  double TwoPi = 6.283185307179586;
  int i, j, n, m, Mmax, Istp;
  double Tmpr, Tmpi, Wtmp, Theta;
  double Wpr, Wpi, Wr, Wi;
  n = Nvl * 2;

  float Tmvl[n];
  //      static float FTvl[2048];

  for (i = 0; i < Nvl; i++) {
    j = i * 2; Tmvl[j] = 0; Tmvl[j + 1] = *(AVal + i);
  }

  i = 1; j = 1;
  while (i < n) {
    if (j > i) {
      Tmpr = Tmvl[i]; Tmvl[i] = Tmvl[j]; Tmvl[j] = Tmpr;
      Tmpr = Tmvl[i + 1]; Tmvl[i + 1] = Tmvl[j + 1]; Tmvl[j + 1] = Tmpr;
    }
    i = i + 2; m = Nvl;
    while ((m >= 2) && (j > m)) {
      j = j - m; m = m >> 1;
    }
    j = j + m;
  }

  Mmax = 2;
  while (n > Mmax) {
    Theta = -TwoPi / Mmax; Wpi = sin(Theta);
    Wtmp = sin(Theta / 2); Wpr = Wtmp * Wtmp * 2;
    Istp = Mmax * 2; Wr = 1; Wi = 0; m = 1;

    while (m < Mmax) {
      i = m; m = m + 2; Tmpr = Wr; Tmpi = Wi;
      Wr = Wr - Tmpr * Wpr - Tmpi * Wpi;
      Wi = Wi + Tmpr * Wpi - Tmpi * Wpr;

      while (i < n) {
        j = i + Mmax;
        Tmpr = Wr * Tmvl[j] - Wi * Tmvl[j - 1];
        Tmpi = Wi * Tmvl[j] + Wr * Tmvl[j - 1];

        Tmvl[j] = Tmvl[i] - Tmpr; Tmvl[j - 1] = Tmvl[i - 1] - Tmpi;
        Tmvl[i] = Tmvl[i] + Tmpr; Tmvl[i - 1] = Tmvl[i - 1] + Tmpi;
        i = i + Istp;
      }
    }

    Mmax = Istp;
  }

  for (i = 0; i < Nft; i++) {
    j = i * 2; FTvl[Nft - i - 1] = (float) sqrt((Tmvl[j] * Tmvl[j]) + (Tmvl[j + 1] * Tmvl[j + 1]));
  }
  //   return FTvl;

}

void sort(double *a, int siz) {
  for (int i = 0; i < (siz - 1); i++) {
    for (int ii = 0; ii < (siz - (i + 1)); ii++) {
      if (a[ii] > a[ii + 1]) {
        double t = a[ii];
        a[ii] = a[ii + 1];
        a[ii + 1] = t;
      }
    }
  }
}

//////////////////// Digital Constants///////////////////////

#include <SPI.h>
#include <SD.h>
#include <genieArduino.h>
#include <Adafruit_CC3000.h>
#include <ccspi.h>
#include <string.h>
#include "utility/debug.h"
#include <PS2Keyboard.h>


Genie genie;

int BSA = 0;
int THC = 1;
int BIOTIN = 2;
int EMPTY = 3;
int sensorType = EMPTY;
int sensorCount = 80;
//int timePoints = 4;
int sensors[80]; //stores 0 for BSA, 1 for THC, 2 for BIOTIN, 3 for EMPTY
int sensorValues[80];//most recent sensor reading
int numActiveSensors;
void initializeSensors();
bool timerExpired = true;
int timerValue = 0;

String userName = "";
String firstName = "";
String middleName = "";
String lastName = "";
String expID = "";
String deviceID = "";
String filename = "";

const int chipSelect = 4;

File dataFile;
File readFile;
File info;


///////////////////////////wifi//////////////////////////////


// These are the interrupt and control pins
#define ADAFRUIT_CC3000_IRQ   3  // MUST be an interrupt pin!
// These can be any two pins
#define ADAFRUIT_CC3000_VBAT  5
#define ADAFRUIT_CC3000_CS    10

Adafruit_CC3000 cc3000 = Adafruit_CC3000(ADAFRUIT_CC3000_CS, ADAFRUIT_CC3000_IRQ, ADAFRUIT_CC3000_VBAT, SPI_CLOCK_DIVIDER); // you can change this clock speed

#define WLAN_SSID       "tyler's iPhone (2)"           // cannot be longer than 32 characters!
#define WLAN_PASS       "sensilabs"
// Security can be WLAN_SEC_UNSEC, WLAN_SEC_WEP, WLAN_SEC_WPA or WLAN_SEC_WPA2
#define WLAN_SECURITY   WLAN_SEC_WPA2

#define IDLE_TIMEOUT_MS  3000      // Amount of time to wait (in milliseconds) with no data 
                                   // received before closing the connection.  If you know the server
                                   // you're accessing is quick to respond, you can reduce this value.

// What page to grab!

//#define WEBSITE      "data.sparkfun.com"
//#define WEBPAGE      "/output/aGOxVAX7VWs3331azdRo.csv"
//char server[] = "data.sparkfun.com";

#define WEBSITE      "sensimetrics.herokuapp.com"
//#define WEBPAGE      "/output/aGOxVAX7VWs3331azdRo.csv"
char server[] = "data.sparkfun.com";

//const String publicKey = "aGOxVAX7VWs3331azdRo";
//const String privateKey = "KEox5am150FzzzRV6Jrv";

const byte NUM_FIELDS = 3;
const String fieldNames[NUM_FIELDS] = {"bsa", "thc", "biotin"};
int fieldData[NUM_FIELDS];


uint32_t ip;
///////////////////////end wifi///////////////////////////////

///////////////////////ID card swipe/////////////////////

const int DataPin = 8;
const int IRQpin =  9;
PS2Keyboard keyboard;


void setup()
{
/////////////////////////////////Analog Set up////////////////
  
  pinMode(MUX_C1, OUTPUT);
  pinMode(MUX_B1, OUTPUT);
  pinMode(PAENABLE, OUTPUT);
  pinMode(MOTOR_CONTROL, OUTPUT);
  pinMode(MUX_B0, OUTPUT);
  pinMode(PA_switch, OUTPUT);
  pinMode(FS_GMR1, OUTPUT);
  pinMode(FS_Coil, OUTPUT);
  pinMode(AUTOGAINA3, OUTPUT);
  pinMode(AUTOGAINA2, OUTPUT);
  pinMode(ADC_SCK, OUTPUT);
  pinMode(MUX_A0, OUTPUT);
  pinMode(MUX_C0, OUTPUT);
  pinMode(MUX_D0, OUTPUT);
  pinMode(MUX_A1, OUTPUT);
  pinMode(AUTOGAINA0, OUTPUT);
  pinMode(AUTOGAINA1, OUTPUT);
  pinMode(SCLK_SIGSYN, OUTPUT);
  pinMode(SDO_SIGSYN, OUTPUT);

  pinMode(ADC_SDI, INPUT);
  pinMode(BUSY, INPUT);
  pinMode(CNV,OUTPUT);
 
  SPI_GMR1_SEND(0x2000); //original
  SPI_GMR1_SEND(0x60B7);
  SPI_GMR1_SEND(0x4001);
  SPI_GMR1_SEND(0xC000);
  SPI_GMR1_SEND(0x2000);

  SPI_COIL_SEND(0x2000);  // 
  SPI_COIL_SEND(0x58BB);  // 
  SPI_COIL_SEND(0x4000);  // 
  SPI_COIL_SEND(0xC000);  // 
  SPI_COIL_SEND(0x2000);  // 

  digitalWrite(PA_switch, HIGH); //low field

  digitalWrite(MOTOR_CONTROL,LOW);

  
/////////////////////////////////////////Digital Setup////////////////////////////////
  
  // make sure that the default chip select pin is set to
  // output, even if you don't use it:
  pinMode(SS, OUTPUT);
  
  
  Serial.begin(115200);  // Serial0 @ 200000 (200K) Baud
  genie.Begin(Serial);   

  genie.AttachEventHandler(myGenieEventHandler); // Attach the user function Event Handler for processing events

  delay (5000); //let the display start up after the reset (This is important)
  
  
  int wifi_SD_switch = 2;
  pinMode(wifi_SD_switch, OUTPUT); // wifi SD switch
  digitalWrite(wifi_SD_switch, HIGH);
  
 
  //Turn the Display on (Contrast))
  genie.WriteContrast(10); // 0 = black 15= brightest
  
  initializeSensors();

  keyboard.begin(DataPin, IRQpin);
  
  bool IDswipe = false;
  bool nameStart = false;
  int whichName = 0;

  genie.WriteStr(3, F("Swipe ID card \n when ready!"));
  
  while(!IDswipe){
//    genie.WriteStr(3, "Waiting for card data");
    if (keyboard.available()) {
      
//      genie.WriteStr(3, "keyboard available");
      
      char c = keyboard.read();

      if(nameStart  && c != '^'){
        if(c == '$'){whichName++;}
        else if(whichName == 0){lastName += c;}
        else if(whichName == 1){firstName += c;}
        else if(whichName == 2){middleName += c;}
      }
      
      if(c == '^'){
        if(!nameStart){nameStart = true;}
        else{IDswipe = true;}
      }
    }
  }

  userName = firstName+ " "+middleName+ " " + lastName;
  char userNameChar[userName.length() + 1];
  userName.toCharArray(userNameChar, userName.length() + 1);

  digitalWrite(10, LOW);
//  genie.WriteStr(3, userNameChar);

  
    // see if the card is present and can be initialized:
  if (!SD.begin(chipSelect)) {
    genie.WriteStr(3, F("SD wont begin, 10 low"));
    while (1) ;
  }
  
// open info file to get expID and device ID
  info = SD.open("info.csv");
  char c = info.read();
  while(c != ','){
    deviceID += c;
    c = info.read();
  }
  while(info.available()){
    c = info.read();
    expID += c;
  }


  int expID_int = expID.toInt() + 1; //add one to previous expID
  expID = String(expID_int);
  filename = expID + ".csv";
  
  info.close();
  SD.remove("info.csv");

  genie.WriteStr(3, userName + "\n Experiment ID: " + expID);
  
  info = SD.open("info.csv", FILE_WRITE);
  String infoString = deviceID + "," + expID;
  info.print(infoString);
  info.close();

  dataFile = SD.open(filename, FILE_WRITE);
  if (! dataFile) {
    genie.WriteStr(3, F("could not open csv file"));
    // Wait forever since we cant write data
    while (1) ;
  }

  //Write header on csv file. create experiment ID.
  String header = userName + "," + expID;
  dataFile.println(header);

    
}

//Set all sensors to Type = EMPTY and current value to 0.
void initializeSensors(){
  for(int i = 0; i < sensorCount; i++){
    sensors[i] = 3;
    sensorValues[i] = 0;
  }
}

//write a line of data to the csv file on the sd card
void writeData(int timePoint, int timerValue, int sensor, int sensorValue){

  String dataString = "";
  dataString += (timePoint);//+1 because analysis is done in Rstudio, which is 1 indexed
  dataString += ",";
  dataString += (timerValue);
  dataString += ",";
  dataString += (sensor);
  dataString += ",";
  String sensorTypeString = "";
  
  if(sensorType == BSA){sensorTypeString = "BSA";}
  else if(sensorType == THC){sensorTypeString = "THC";}
  else if(sensorType == BIOTIN){sensorTypeString = "BIOTIN";}
  
  dataString += sensorTypeString;
  dataString += ",";
  dataString += (sensorValue);
  
  dataFile.println(dataString);
  dataFile.flush();   
}


void loop()
{

  static long waitPeriod = millis();
  genie.DoEvents(); // This calls the library each loop to process the queued responses from the display

  if (millis() >= waitPeriod)
  {
    waitPeriod = millis() + 50; // rerun this code to update Cool Gauge and Slider in another 50ms time.
  }
}

void myGenieEventHandler(void){
  
  genieFrame Event;
  genie.DequeueEvent(&Event);


  //If the cmd received is from a Reported Event (Events triggered from the Events tab of Workshop4 objects)
  if (Event.reportObject.cmd == GENIE_REPORT_EVENT)
  {
    
    if(Event.reportObject.object == GENIE_OBJ_WINBUTTON){
      if(Event.reportObject.index == 0){
        genie.WriteObject(GENIE_OBJ_FORM, 1, 0);
      }
      if(Event.reportObject.index < 5 && Event.reportObject.index > 0){
        sensorType = Event.reportObject.index - 1; 
      }
      if(Event.reportObject.index == 5){ // Set Layout Button
        genie.WriteObject(GENIE_OBJ_FORM, 2, 0);  
     
      }
      if(Event.reportObject.index == 7){ //start experiment button

         for (int a = 0; a < 80; a++){ //State 99 initialize arrays
           mr0[a] = 0;
           Ic_original[a] = 0;
           Is_original[a] = 0;
           table[a] = 0;
         }
         mr_cal = 0;

        matchResistances();//State 1

        int readCount = 0;    
        long waitPeriod, startMillis = millis();
        timerExpired = false;
        String calibrationString = "";
        int percent = 0;
        

        dataFile.println("Iteration,Time,Sensor,Type,Value");

        while(!timerExpired){
//          if(millis()>waitPeriod){
            timerValue = (millis()-startMillis)/1000;
            genie.WriteStr(3, F(" "));//for some bizzare reason, need this in order for timer to stop when stop button is pressed
            int minutes = timerValue/60;
            int seconds = timerValue%60;
            int timerDisplay = minutes*100+seconds;
            genie.WriteObject(GENIE_OBJ_LED_DIGITS, 0, timerDisplay);
            waitPeriod +=1000;//1 sec
            calcMeanValues();
//          }
          genie.DoEvents();
          
          if(readCount < sensorCount && sensors[readCount%80] != EMPTY){
//          if(readCount < sensorCount){
            mr_cal = 0;
            digitalWrite(PA_switch, HIGH);//Low field
            percent = readCount*100/sensorCount;
            calibrationString = "First read is: \n" + String(percent) + "% Complete";
            genie.WriteStr(4, calibrationString);
            collectSensorValue(readCount);
          }
          
          else if(readCount < 2*sensorCount && sensors[readCount%80] != EMPTY){
            mr_cal = 1;
            digitalWrite(PA_switch, LOW);//HIGH field
            
            percent = (readCount - sensorCount)*100/sensorCount;
            calibrationString = "Second read is: \n" + String(percent) + "% Complete";
            genie.WriteStr(4, calibrationString);
            collectSensorValue(readCount);
          }else {
            mr_cal = 0;
            collectSensorValue(readCount);
          }
          
          readCount++;
        }

      }
      if(Event.reportObject.index == 6){// stop experiment button
        genie.WriteStr(4, F("stop pressed"));
        dataFile.close();
        timerExpired = true;
      
      }
      if(Event.reportObject.index == 8){// stop experiment button
      timerExpired = true;
//      SD.end();
      sendDataWifi();
    
      }
      
      
      
    }
    if (Event.reportObject.object == GENIE_OBJ_USERBUTTON){      
      updateLayout(Event.reportObject.index, sensorType); 
    }
  }

}

//both set the correct sensor color on the LED display and update our sensor (type) array
void updateLayout(int index, int type){
  int BSAindex = index;
  int THCindex = index + sensorCount*THC;
  int BIOindex = index + sensorCount*BIOTIN;
  int selectedLED = index + sensorCount*type;

  
    //set all to off (display grey)
  genie.WriteObject(GENIE_OBJ_USER_LED, BSAindex, 0);
  genie.WriteObject(GENIE_OBJ_USER_LED, THCindex, 0);
  genie.WriteObject(GENIE_OBJ_USER_LED, BIOindex, 0);
  
  if(type != EMPTY){// display color if not EMPTY
    genie.WriteObject(GENIE_OBJ_USER_LED, selectedLED, 1);
    if(sensors[index] == EMPTY){ //only add to numActiveSensors if previous type was EMPTY 
      numActiveSensors++;
    }
  }else if(sensors[index] != EMPTY){ //only subtract from numActiveSensors if previous type was not EMPTY
    numActiveSensors--;
  }
  
  sensors[index] = type;
}
  

void collectSensorValue(int readCount){

  int sensor = readCount%80;
  sensorType = sensors[sensor];
  if(sensorType == EMPTY){return;}

  int timePoint = readCount/80;

  int row = (int)(sensor / 8);
  int col = sensor - 8*row;

  AUTOGAINMUX_on(autogainres[sensor]);

  int muxRow = rowToMux[row];
  int muxCol = colarray[col];

  MULTIPLIER1_on(muxCol);
  MULTIPLIER2_on(muxRow);

//  int sensorValue = (sensorType + 1)*sensor*(1-pow(2.3, -0.008*timerValue));//generate simulated data

  delay(100);
  {

    for (int a = 0; a < 10; a++)
    {
      w = SPI_ADC_RECEIVE();
      AVal[a] = w;
    }
    
    for (int a = 0; a < N; a++) // N = 2^12 data points
    {
      w = SPI_ADC_RECEIVE();
      AVal[a] = w;
    }
    
    for (int a = 0; a < N; a++) //
    {
      if(AVal[a] >= 524288 )
      {
        AVal[a] = AVal[a]- 1048576;
      }                  
    }
    
    int mean_long = 0;
    for (int ii = 0; ii < N; ii++)
    {
      mean_long = AVal[ii] + mean_long; //sum up
    }
    mean_long=  (mean_long / N); //get mean

    for (int ii = 0; ii < N; ii++)
    {
      AVal[ii] = ( (AVal[ii] - mean_long) * hann[ii] );
    }

    FFTAnalysis(FTvl, AVal,  Nvl,  Nft);

    for (int i = 0; i < N; i++)
    {
      FTvl[i] = FTvl[i] / N * 10  / 1048576;
    }

    //tracker
    for (int i = 0; i < 51; i++)
    {
      tempcarrierarray[i] =  FTvl[carrierfrequency - 25 + i];
    }

    sort(tempcarrierarray, 51);

    for (int i = 0; i < 51; i++)
    {
      if (tempcarrierarray[50] == FTvl[carrierfrequency - 25 + i])
      {
        tempcarrierfrequency = carrierfrequency - 25 + i;
      }
    }

    for (int i = 0; i < 51; i++)
    {
      tempsidearray[i] =  FTvl[sidefrequency - 25 + i];
    }

    sort(tempsidearray, 51);
    for (int i = 0; i < 51; i++)
    {
      if (tempsidearray[50] == FTvl[sidefrequency - 25 + i])
      {
        tempsidefrequency = sidefrequency - 25 + i;
      }
    }

    for (int i = 0; i < 51; i++)
    {
      tempsidearray[i] =  FTvl[sidefrequency2 - 25 + i];
    }

    sort(tempsidearray, 51);
    for (int i = 0; i < 51; i++)
    {
      if (tempsidearray[50] == FTvl[sidefrequency2 - 25 + i])
      {
        tempsidefrequency2 = sidefrequency2 - 25 + i;
      }
    }
  }

  carriermul = FTvl[tempcarrierfrequency] * FTvl[tempcarrierfrequency];
  for (int i = 1; i < freq_bin ; i++)
  {
    carriermul =  carriermul + FTvl[tempcarrierfrequency + i] * FTvl[tempcarrierfrequency + i] + FTvl[tempcarrierfrequency - i] * FTvl[tempcarrierfrequency - i];
  }

  sidemul = FTvl[tempsidefrequency] * FTvl[tempsidefrequency];
  for (int i = 1; i < side_bin1; i++)
  {
    sidemul = sidemul + FTvl[tempsidefrequency + i] * FTvl[tempsidefrequency + i] + FTvl[tempsidefrequency - i] * FTvl[tempsidefrequency - i];
  }


  sidemul2 = FTvl[tempsidefrequency2] * FTvl[tempsidefrequency2];
  for (int i = 1; i < side_bin2; i++)
  {
    sidemul2 =  sidemul2 + FTvl[tempsidefrequency2 + i] * FTvl[tempsidefrequency2 + i] + FTvl[tempsidefrequency2 - i] * FTvl[tempsidefrequency2 - i];
  }

  sidemul = (sidemul + sidemul2) / 2;



  Ic =  involt_rms * AMP1[sensor]   + sqrt((double)(2 * (carriermul))) / AMP23; // / AMP1[row * 8 + col]  ;
  Is =  sqrt( 2 * (sidemul ) ) / AMP23;// / AMP1[row * 8 + col] ;


  if (table[sensor] == 0)
  {
    table[sensor] = 1;
    Ic_original[sensor] = (double)Ic;
    Is_original[sensor] = (double)Is;
    mr0[sensor] = (double)(((Ic_original[sensor] + 2 * Is_original[sensor] ) / (Ic_original[sensor] - 2 * Is_original[sensor] ) - 1) * 1000000);

  }


  CF =  (double)(1 / (1 + k * (Ic / Ic_original[sensor] - 1) ));
  corrected_Is = (double)(Is * CF);

  if (mr_cal == 1)
  {
    correctedmr = (( Ic_original[sensor] + 2 * corrected_Is ) / (Ic_original[sensor] - 2 * corrected_Is ) - 1) * 1000000 ;
    deltamr = correctedmr - mr0[sensor]; // always returns 0???
    mr_factor[sensor] = (double)(abs(mrmedian / deltamr));// always returns inf???
//    String mr_factor_str = "deltamr for sensor: " + String(sensor) + " is ";
//    dataFile.println(mr_factor_str);
//    dataFile.println(deltamr);
  }
  else if (mr_cal == 0)
  {
    correctedmr = (( Ic_original[sensor] + 2 * corrected_Is ) / (Ic_original[sensor] - 2 * corrected_Is ) - 1) * 1000000 ;      
    deltamr = mr_factor[sensor]* (correctedmr - mr0[sensor]) ;
  }

  if (deltamr < 29000)
  {
    two_byte_short = (short)(round(deltamr)) + 3000;
  }

  if (two_byte_short < 0)
  {
    two_byte_short = -two_byte_short;
  }


  if (two_byte_short < 32000)
  {
    ToSendDataBuffer1[0] = (byte)two_byte_short;
    ToSendDataBuffer1[1] = (byte)( two_byte_short  >> 8);
  }
  else
  {
    ToSendDataBuffer1[0] = (byte)32000;
    ToSendDataBuffer1[1] = (byte)( 32000  >> 8);
  }

//  int sensorValue = ToSendDataBuffer1[0];
  int sensorValue = two_byte_short;

//  Serial.write(ToSendDataBuffer1, 2);

  sensorValues[sensor]= sensorValue;
  
  writeData(timePoint, timerValue, sensor, sensorValue);
  delay(20);
  
}

void calcMeanValues(){
  int BSAsum = 0;
  int THCsum = 0;
  int BIOTINsum = 0;
  int numBSAsensor = 0;
  int numTHCsensor = 0;
  int numBIOTINsensor = 0;
  
  for(int i = 0; i < sensorCount; i++){
    int type = sensors[i];

    if(type == BSA){
      BSAsum += sensorValues[i];
      numBSAsensor++;
    }
    else if(type == THC){
      THCsum += sensorValues[i];
      numTHCsensor++;
    }
    else if(type == BIOTIN){
      BIOTINsum += sensorValues[i];
      numBIOTINsensor++;
    }
  }

  int BSAmean = BSAsum/numBSAsensor;
  int THCmean = THCsum/numTHCsensor;
  int BIOTINmean = BIOTINsum/numBIOTINsensor;

  String meanString = "Mean: \n";
  String BSAmeanString = meanString + BSAmean;
  String THCmeanString = meanString + THCmean;
  String BIOTINmeanString = meanString + BIOTINmean;

  char BSAmeanChar[BSAmeanString.length() + 1];
  char THCmeanChar[THCmeanString.length() + 1];
  char BIOTINmeanChar[BIOTINmeanString.length() + 1];
  
  BSAmeanString.toCharArray(BSAmeanChar, BSAmeanString.length() + 1);
  THCmeanString.toCharArray(THCmeanChar, THCmeanString.length() + 1);
  BIOTINmeanString.toCharArray(BIOTINmeanChar, BIOTINmeanString.length() + 1);

  genie.WriteStr(BSA, BSAmeanChar);
  genie.WriteStr(THC, THCmeanChar);
  genie.WriteStr(BIOTIN, BIOTINmeanChar);

  fieldData[BSA] = BSAmean;
  fieldData[THC] = THCmean;
  fieldData[BIOTIN] = BIOTINmean;

}

void sendDataWifi(){
 
  int wifiConsol = 4;

  digitalWrite(2, LOW);//??? dont remember why i put that 

  genie.WriteStr(wifiConsol, F("beginning wifi..."));

  if (!cc3000.begin())
  {
    genie.WriteStr(wifiConsol, F("Couldn't begin()! Wifi plugged in?"));
    while(1);
  }
  
  genie.WriteStr(wifiConsol, F("\nAttempting to connect to \n tyler's iPhone (2)")); 

  if (!cc3000.connectToAP(WLAN_SSID, WLAN_PASS, WLAN_SECURITY)) {
    genie.WriteStr(wifiConsol, F("Failed!"));
    while(1);
  }
   
  genie.WriteStr(wifiConsol, F("Connected!"));

  genie.WriteStr(wifiConsol, F("Requesting DHCP..."));
  while (!cc3000.checkDHCP())
  {
    delay(100); // ToDo: Insert a DHCP timeout!
  }  

  
  genie.WriteStr(wifiConsol, F("getHostByName()"));
  // Try looking up the website's IP address
  genie.WriteStr(wifiConsol, F(WEBSITE));
  while (ip == 0) {
    if (! cc3000.getHostByName(WEBSITE, &ip)) {
      genie.WriteStr(wifiConsol, F("Couldn't resolve!"));
    }
  }

  Adafruit_CC3000_Client www = cc3000.connectTCP(ip, 80);
  if (www.connected()) {
    genie.WriteStr(wifiConsol, F("Successfully connected"));

    www.println();
  } else {
    genie.WriteStr(wifiConsol, F("Connection failed"));    
    return;
  }


genie.WriteStr(wifiConsol, F("sending GET request"));

  String getString = "GET /incomingData";
  for(int i = 0; i < NUM_FIELDS; i++){
    getString += "/";
    getString += fieldData[i];
  }

  //add ref
  getString += "/";
  getString += 4;
//  add user
  getString += "/";
  getString += firstName +"%20" +middleName +"%20" + lastName;
  //add experiment_id
  getString += "/";
  getString += expID;
  //add device_id
  getString += "/";
  getString += 1;

  getString += " HTTP/1.1";
  www.println(getString);

  www.println("Host: sensimetrics.herokuapp.com");
  www.println("Connection: close");
  www.println();

  while(www.available()){
    char c = www.read();
  }

  www = cc3000.connectTCP(ip, 80);
      
  genie.WriteStr(wifiConsol, F("sending whole file..."));

  //send user name to AWS file
//  getString = "GET /incomingFile/user/" + firstName +"%20" +middleName +"%20" + lastName;
//  getString += " HTTP/1.1";
//  www.println(getString);
//  www.println("Host: sensimetrics.herokuapp.com");
//  www.println("Connection: keep-alive");
//  www.println();
//
//  while(www.available()){
//    char c = www.read();
//  }

//  genie.WriteStr(wifiConsol, F("sent user name"));
  
  getString = "GET /incomingFile/expID/" + expID;
  getString += " HTTP/1.1";
  www.println(getString);
  www.println("Host: sensimetrics.herokuapp.com");
  www.println("Connection: keep-alive");
  www.println();

  while(www.available()){
    char c = www.read();
  }
  
  File readFile = SD.open(filename);

  int count = 0;
  String POST_BODY = "fileContent=";
  bool lastSent = true;
  while(readFile.available()){ 

    if(lastSent){
      POST_BODY = "fileContent=";
      
      for(int i = 0; i < 30; i++){
        if(readFile.available()){
          char c = readFile.read();
          POST_BODY += c;
        }
      }
    }
    
    genie.WriteStr(wifiConsol, String(count));
    if (www.connected()) {
      www.fastrprintln(F("POST /dataUploadFromArduino HTTP/1.1"));
      www.fastrprintln(F("Host: sensimetrics.herokuapp.com"));
      www.fastrprintln(F("Content-Type: application/x-www-form-urlencoded"));
      www.fastrprint(F("Content-length: "));
//      char stringBuffer[8];
//      sprintf(stringBuffer, "%d", POST_BODY.length());
//      www.fastrprint(stringBuffer);
      www.println(POST_BODY.length());
      www.println();
      www.println(POST_BODY); 
      lastSent = true;   
    }else{
      www = cc3000.connectTCP(ip, 80);
      if (www.connected()) {
        genie.WriteStr(wifiConsol, F("Successfully re-connected"));
        delay(1000);
        www.println();
      } else {
        genie.WriteStr(wifiConsol, F("Connection failed"));   
        delay(1000); 
        return;
      }
      lastSent = false;
    }

    while(www.available()){
      char c = www.read();
    } 
    count++;
  }
  readFile.close();


  genie.WriteStr(wifiConsol, F("sent post"));

  www = cc3000.connectTCP(ip, 80);
  
  getString = "GET /incomingFile/DONE/end_file";
  getString += " HTTP/1.1";
  www.println(getString);
  www.println("Host: sensimetrics.herokuapp.com");
  www.println("Connection: close");
  www.println();


  String res = "";
  while (www.connected())
  {
    genie.WriteStr(wifiConsol, res);
    if ( www.available() )
    {
      char c = www.read();
      res += c;
    }
  }
  cc3000.disconnect(); 
}

void matchResistances(){
  int startTime = millis();
  
  for (int a = 0; a++; a < 80)
  {
    autogainres[a] = 256;
  }

  int activeCount = 0;
  int activePercent = 0;
  String calibrationDisplay = "";
    
  for ( rowncoln = 0; rowncoln < sensorCount; rowncoln++)
  {

    if(sensors[rowncoln] != EMPTY){
      
      activeCount++;
      activePercent = activeCount*100/numActiveSensors;
      calibrationDisplay = "Res Matching is: \n" + String(activePercent) + "% Complete";
      genie.WriteStr(4, calibrationDisplay);
      
      
      row = (int)(rowncoln / 8);
      col = rowncoln - 8 * (int)(rowncoln / 8); //rowncoln % 8;
      
      int muxRow = rowToMux[row];
      int muxCol = colarray[col];
  
      MULTIPLIER2_on(muxRow);
      MULTIPLIER1_on(muxCol); ////////////////SHOULD BE CHECKED
  
      // for the current sensor initialize faulty to be false for every resistor
      for (int a = 0; a < 16; a++)
      {
        faulty[a] = false;
      }
  
      // compare current sensor to 16 resistors
      wrangesmallest = 15;
      for (res = 15; res >= 0; res--)
      {
        AUTOGAINMUX_on(res);//(*(resarray+res));
        for (ab = 0; ab < 5; ab++);
  
        for (int a = 0; a < 250; a++) //buffer
        {
          wint = SPI_ADC_RECEIVE();   
        }
  
        for (int a = 0; a < 150; a++)
        {
          wint = SPI_ADC_RECEIVE();
          
           if(wint >= 524288 )
            {
              wint = wint - 1048576;
            }       
  
          if (a == 0) //after the first reading set that reading to both min and max
          {
            wmax = wint;
            wmin = wint;
          }
          else
          {
            if ((wmax < wint))
            {
             wmax = wint;
            }
            if ((wmin > wint))
            {
              wmin = wint;
            }
            if ( wint > 201860 || wint < -201860 )
            {
              faulty[res] = true;
            }
  
          }
  
  
        }//end comparison of single sensor to one resistor
  
        wrange[res] = wmax - wmin;
        if (wrange[res] < wrange[wrangesmallest])
        {
          wrangesmallest =  res;
        }
      }//autogain for end
//      autogainres[row * 8 + col] = wrangesmallest;
      autogainres[rowncoln] = wrangesmallest;
      
      faultysensor = true;
      for(int i = 0; i < 16; i++){
        if(faulty[i] == false){
          faultysensor = false;
        }
      }

//    labeling sensors as faulty
      if (faultysensor == true)
      {
        autogainres[rowncoln] = 0; //4;
      }else if (autogainres[rowncoln] != 15)
      {
        autogainres[rowncoln] = autogainres[rowncoln] + 1; //4;
      }
//
//      if (autogainres[rowncoln] != 15)
//      {
//        autogainres[rowncoln] = autogainres[rowncoln] + 1; //4;
//  
//      }
  
    }//end if !=EMPTY
    else{
      autogainres[rowncoln] = 255;
    }
    
   }//row end column end
  autogain = true;

  for (int a = 0; a < sensorCount; a++) //6
  {
    //  for (ab = 0; ab < 10; ab++);

    w = (unsigned long int)autogainres[a];

    ToSendDataBuffer1[2 * a] = w;
    ToSendDataBuffer1[2 * a + 1] = w >> 8;
  }

  dataFile.println("Reference resistors:  ");  
  int rowEntry = 0;
  String rowString = "";
  for(int i = 0; i < sensorCount; i++){
    if(rowEntry < 8){
      rowString += autogainres[i];
      rowString += ",";
      rowEntry++;
    }else{
      dataFile.println(rowString);
      rowString = autogainres[i];
      rowString += ",";
      rowEntry = 1;
    } 
  }
//  for(int i = 0; i < 160; i++){
//    if(rowEntry < 16){
//      if(i%2 == 0){
//        rowString += ToSendDataBuffer1[i];
//        rowString += ",";
//      }
//      rowEntry++;
//    }else{
//      dataFile.println(rowString);
//      rowString = ToSendDataBuffer1[i];
//      rowString += ",";
//      rowEntry = 1;
//    } 
//  }
  dataFile.println(rowString);//print last row of res matches

  for (int a = 0; a < 80; a++) //6
  {
    AMP1[a] = ( 2490 / resistorarray[ autogainres[a] ] );
  }

  flag = 1;
}



